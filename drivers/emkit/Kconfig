## drivers/emkit/Kconfig
```kconfig
config EMKIT_INFO
	tristate "Detect modules for EMKIT"
	help
	  Say Y here if you want to generate a sysfs entry for
	  detecting module on Android.

	  If unsure, say N.

	  To compile this driver as a module, choose M here: the
	  module will be called emkit_info.
```

## drivers/input/finger/Kconfig
```kconfig
# SPDX-License-Identifier: GPL-2.0-only
#
# Fingerprint driver configuration
#
menuconfig INPUT_FINGERPRINT
	bool "Fingerprint"
	default y
	help
	  Say Y here, and a list of supported Fingerprint will be displayed.
	  This option doesn't affect the kernel.

	  If unsure, say Y.

if INPUT_FINGERPRINT

source "drivers/input/finger/focal_finger/Kconfig"

endif
```

## drivers/input/finger/focal_finger/Kconfig
```kconfig
# SPDX-License-Identifier: GPL-2.0-only
#
# Focaltek Fingerprint driver configuration
#

config FINGER_FOCAL
	tristate "FINGER FOCAL fingerprint"
	help
	  Say Y here if you have a FINGER FOCAL fingerprint and want to enable
	  support for the built-in touchscreen.

	  If unsure, say N.

	  To compile this driver as a module, choose M here: the
	  module will be called FINGER_FOCAL.
```
